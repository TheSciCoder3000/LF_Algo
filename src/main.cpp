// External libraries
#include <Arduino.h>
#include <ArduinoJson.h>

// internal libraries
#include <lf_server.h>
#include <lf_motor.h>
#include <lf_sensor.h>

#include "oled.h"
#include <sstream>
#include <string>

#define e1 12 // Right Motor Enable Pin EA
#define m1 16 // Right Motor MA1
#define m2 17 // Right Motor MA2
#define m3 18 // Left Motor MB1
#define m4 19 // Left Motor MB2
#define e2 14 // Left Motor Enable Pin EB

#define ir1 39
#define ir2 34
#define ir3 35
#define ir4 32
#define ir5 33

LfMotor RightMotor, LeftMotor;
IRSensor sensor;

Adafruit_SH1106G display = Adafruit_SH1106G(SCREEN_WIDTH, SCREEN_HEIGHT, &Wire, OLED_RESET);
WebServer server(HTTP_REST_PORT);

const char *ssid = "9";
const char *password = "jvyen30609";

void restServerRouting();
void showConnection();
void parsePIDValues(String data);
void parseIndiValues(char portion, String data);
String getValue(String data, char separator, int index);
void linefollow(int _error);

float P, D, I, previousError, PIDvalue, error;
int lsp, rsp;
int lfspeed = 200;
bool start = false;
bool isR90 = false;
bool isL90 = false;

float Kp = 0.06;
float Kd = 0;
float Ki = 0;

int minSpeed = -100;

StaticJsonDocument<1024> jsonDocument;
char buffer[1024];

// 'neuro', 128x64px
const unsigned char epd_bitmap_neuro[] PROGMEM = {
    0xff, 0xff, 0xff, 0xff, 0xff, 0xff, 0xff, 0xff, 0xff, 0xff, 0xff, 0xff, 0xff, 0xff, 0xff, 0xff,
    0xff, 0xff, 0xff, 0xff, 0xff, 0xff, 0xff, 0xff, 0xff, 0xff, 0xff, 0xff, 0xff, 0xff, 0xff, 0xff,
    0xff, 0xff, 0xff, 0xff, 0xff, 0xff, 0xff, 0xff, 0xff, 0xff, 0xff, 0xff, 0xff, 0xff, 0xff, 0xff,
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    0xff, 0xff, 0xff, 0xff, 0xff, 0xff, 0xff, 0xff, 0xff, 0xff, 0xff, 0xff, 0xff, 0xff, 0xff, 0xff};

void setup()
{
  // INITIALIZE SERIAL AND OLED
  Serial.begin(9600);
  RightMotor.begin(e2, m3, m4);
  LeftMotor.begin(e1, m1, m2);

  // RightMotor.drive(255);
  // LeftMotor.drive(255);
  // delay(10000);
  // RightMotor.drive(255);
  // LeftMotor.drive(-255);
  // delay(10000);
  // RightMotor.drive(-255);
  // LeftMotor.drive(255);
  // delay(10000);
  // RightMotor.drive(0);
  // LeftMotor.drive(0);
  // delay(10000);

  display.begin(i2c_Address, true); // Address 0x3C default
  sensor.begin(ir1, ir2, ir3, ir4, ir5);

  // Display Custom Logo
  display.clearDisplay();
  display.drawBitmap(0, 0, epd_bitmap_neuro, 128, 64, 1);
  display.display();
  delay(5000);
  display.clearDisplay();

  // ======================== Initialize Bluetooth ========================
  display.setTextSize(1);
  display.setTextColor(SH110X_WHITE);
  display.setCursor(0, 0);
  display.println(F("Bluetooth Device \nInitialized"));
  display.display();
  delay(2000);

  // ======================== CONNECT TO WIFI ========================
  WiFi.begin(ssid, password);
  Serial.print(F("connecting to wifi "));

  // text display tests
  display.clearDisplay();
  display.setCursor(0, 0);
  display.println(F("Connecting to wifi:"));
  display.display();
  delay(2000);
  display.clearDisplay();

  int reconnectionCounter = 0;
  while (WiFi.status() != WL_CONNECTED)
  {
    if (reconnectionCounter > 30)
    {
      display.clearDisplay();
      display.println("Failed to connect to wifi");
      display.display();
      delay(2000);
      break;
    }
    String loadingBar = "";
    for (int i = 0; i < reconnectionCounter; i++)
    {
      loadingBar.concat(".");
    }

    display.clearDisplay();
    display.setCursor(0, 0);
    display.println("Connecting");
    display.println(loadingBar);
    display.display();
    delay(1000);

    Serial.print(".");

    reconnectionCounter++;
  }

  if (WiFi.status() == WL_CONNECTED)
  {
    display.clearDisplay();
    Serial.print(F("\n Connected: "));

    showConnection();
    Serial.println(WiFi.localIP());
    delay(7500);

    restServerRouting();
    server.begin();
    Serial.println(F("HTTP Server started"));
  }
}

void loop()
{
  server.handleClient();
  // ============================ REST API ============================
  sensor.read();

  // display.clearDisplay();
  // display.setCursor(0, 0);
  // display.print(Kp);
  // display.print(" | ");
  // display.print(Ki);
  // display.print(" | ");
  // display.print(Kd);
  // display.print("\r");

  // display.display();

  if (start)
  {
    // display.clearDisplay();
    // display.setCursor(0, 0);
    // display.println("Running");
    // display.display();

    // if (sensor.isIntersection())
    // {
    //   delay(100);
    // }
    // else if (sensor.is90Left())
    // {
    //   display.clearDisplay();
    //   display.setCursor(0, 0);
    //   display.println("going left");
    //   display.display();
    //   RightMotor.drive(255);
    //   LeftMotor.drive(0);
    // }
    // else if (sensor.is90Right())
    // {
    //   display.clearDisplay();
    //   display.setCursor(0, 0);
    //   display.println("going right");
    //   display.display();
    //   RightMotor.drive(0);
    //   LeftMotor.drive(255);
    // }
    // else
    // {
    display.clearDisplay();
    display.setCursor(0, 0);
    display.println("following line");
    display.display();
    linefollow(sensor.getError());
    // }
  }
  else
  {
    LeftMotor.drive(0);
    RightMotor.drive(0);
  }
}

void linefollow(int _error)
{
  int error = _error;

  P = error;
  I = I + error;
  D = error - sensor.prevError;

  PIDvalue = (Kp * P) + (Ki * I) + (Kd * D);
  sensor.prevError = error;

  lsp = lfspeed + PIDvalue;
  rsp = lfspeed - PIDvalue;

  if (lsp > 255)
  {
    lsp = 255;
  }
  if (lsp < minSpeed)
  {
    lsp = minSpeed;
  }
  if (rsp > 255)
  {
    rsp = 255;
  }
  if (rsp < minSpeed)
  {
    rsp = minSpeed;
  }

  Serial.print(lsp);
  Serial.print(" | ");
  Serial.print(rsp);
  // Serial.print(PIDvalue);
  // Serial.print(error);
  Serial.print("\r");

  display.clearDisplay();
  display.setCursor(0, 0);
  display.print(lsp);
  display.print(" | ");
  display.print(rsp);

  LeftMotor.drive(lsp);
  RightMotor.drive(rsp);
}

void showConnection()
{
  display.setTextSize(1);
  display.setTextColor(SH110X_WHITE);
  display.setCursor(0, 0);
  display.println(F("Wifi Connected:"));
  display.println(F("SUCCESS\n"));
  display.println(F("IP Address:"));
  display.println(WiFi.localIP());
  display.display();
}

void restServerRouting()
{
  server.on(
      F("/connect"),
      HTTP_GET,
      []()
      {
        server.send(200);
        display.clearDisplay();

        display.setCursor(0, 0);
        display.println(F("User has connected!!!!"));
        display.display();

        delay(5000);
        display.clearDisplay();

        showConnection();
      });

  server.on(
      F("/set"),
      HTTP_POST,
      []()
      {
        String body = server.arg("plain");
        deserializeJson(jsonDocument, body);
        // Get RGB components
        Kp = (float)jsonDocument["kp"];
        Ki = (float)jsonDocument["ki"];
        Kd = (float)jsonDocument["kd"];
        lfspeed = (int)jsonDocument["speed"];
        sensor.innerWeight = (float)jsonDocument["inner"];
        sensor.outerWeight = (float)jsonDocument["outer"];

        Serial.println((float)jsonDocument["kp"]);

        // Respond to the client
        server.send(200, "application/json", "{}");
      });
  server.on(
      F("/cmd"),
      HTTP_POST,
      []()
      {
        String body = server.arg("plain");
        deserializeJson(jsonDocument, body);
        // Get RGB components
        String act = jsonDocument["action"];
        start = act == "START";

        // Respond to the client
        server.send(200, "application/json", "{}");
      });
}
